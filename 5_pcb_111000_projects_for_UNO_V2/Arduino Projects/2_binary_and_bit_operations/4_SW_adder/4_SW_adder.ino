
/*
This program adds two binary numbers
The bits are summed in pairs.
Each summations may produce a carry
which must be added to the next two bits.

See
https://www.geeksforgeeks.org/digital-logic/binary-adder-with-logic-gates/

for an explanation.

Notice that some of the logic functions we have been looking at are key components
in an adder. We implement them here in software.  When implemented in hardware
they are called logic gates 

Bit_adder truth table

Inputs are A, B and Carry_in: Cin
Outputs are Sum and Carry_out: Cout

Logic adder truth table fot one pair of bits A and B
Cin is the carry generated by the previus pair if bits
Cout is the carry to be passed to the next summation.

A             0 0 0 0 1 1 1 1
B             0 0 1 1 0 0 1 1
Cin           0 1 0 1 0 1 0 1
A^B           0 0 1 1 1 1 0 0
(A^B)^Cin     0 1 1 0 1 0 0 1
Sum           0 1 1 0 1 0 0 1
Cout          0 0 0 1 0 1 1 1

if Cin is zero  Cout is A&B
if Cin is unity Cout is A|B
*/



#include "SW_adder.h"
#include "KBD_to_display.c"

int main (void) {
long Num_A, Num_B, Num_C;
char digits[8]; 

setup_HW_basic;
for(int m = 0; m <= 7; m++)digits[m] = 0;
I2C_Tx_any_segment_clear_all();

if(watch_dog_reset != 1)String_to_PC_Basic
("\r\nEnter 2 numbers to be added together\r\n\
Then press sw1\r\n");
else String_to_PC_Basic("\r\n");

while(switch_1_down);

Num_A = Int_KBD_to_display_Local(digits);
Num_B = Int_KBD_to_display_Local(digits);
Num_C = Logic_Add (Num_A, Num_B);

for(int m = 0; m <= 7; m++)digits[m] = 0;
 I2C_Tx_any_segment_clear_all();

digits[0] = Num_A;
digits[1] = Num_B;
digits[2] = Num_C;
I2C_Tx_BWops(digits);
String_to_PC_Basic(" = ");
Long_Hex_and_Int_to_PC_Basic (10, Num_C);

while(switch_1_up);
SW_reset;}



/**************Type subroutines Logic_Add and bit_sum here******************************/






/*************************************************************************************/
long High_bits(long Num)
{return Num >> 16;}


long Low_bits(long Num)
{return Num & 0xFFFF;}








/*****************************************************************************************************************************************/
